#include "tft.h"
#include "config.h"
#include "main.h"

extern SPI_HandleTypeDef hspi2;

#if CFG_TFT_CONTROLLER == TFT_ST7735
#define NATIVE_W 128
#define NATIVE_H 160
#else
#define NATIVE_W 240
#define NATIVE_H 320
#endif

static uint16_t width = NATIVE_W, height = NATIVE_H;

/* Font 5x7 ASCII 0x20..0x7E, moi ky tu 5 cot, bit 0 = hang tren */
static const uint8_t font5x7[95][5] = {
    {0x00,0x00,0x00,0x00,0x00},{0x00,0x00,0x5F,0x00,0x00},{0x00,0x07,0x00,0x07,0x00},{0x14,0x7F,0x14,0x7F,0x14},
    {0x24,0x2A,0x7F,0x2A,0x12},{0x23,0x13,0x08,0x64,0x62},{0x36,0x49,0x55,0x22,0x50},{0x00,0x05,0x03,0x00,0x00},
    {0x00,0x1C,0x22,0x41,0x00},{0x00,0x41,0x22,0x1C,0x00},{0x08,0x2A,0x1C,0x2A,0x08},{0x08,0x08,0x3E,0x08,0x08},
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    {0x00,0x00,0x7F,0x00,0x00},{0x00,0x41,0x36,0x08,0x00},{0x08,0x04,0x08,0x10,0x08},
};

static void cs(int l)  { HAL_GPIO_WritePin(TFT_CS_GPIO_Port, TFT_CS_Pin, l ? GPIO_PIN_SET : GPIO_PIN_RESET); }
static void dc(int l)  { HAL_GPIO_WritePin(TFT_DC_GPIO_Port, TFT_DC_Pin, l ? GPIO_PIN_SET : GPIO_PIN_RESET); }

static void spi_tx(const uint8_t *d, uint16_t n)
{
    HAL_SPI_Transmit(&hspi2, (uint8_t *)d, n, 100);
}

static void write_cmd(uint8_t c, const uint8_t *data, uint8_t n)
{
    cs(0);
    dc(0);
    spi_tx(&c, 1);
    if (n) {
        dc(1);
        spi_tx(data, n);
    }
    cs(1);
}

static void set_window(uint16_t x0, uint16_t y0, uint16_t x1, uint16_t y1)
{
    uint8_t a[4] = { (uint8_t)(x0 >> 8), (uint8_t)x0, (uint8_t)(x1 >> 8), (uint8_t)x1 };
    uint8_t b[4] = { (uint8_t)(y0 >> 8), (uint8_t)y0, (uint8_t)(y1 >> 8), (uint8_t)y1 };
    write_cmd(0x2A, a, 4);
    write_cmd(0x2B, b, 4);
    write_cmd(0x2C, NULL, 0);
}

void tft_backlight(int on)
{
    HAL_GPIO_WritePin(TFT_LED_GPIO_Port, TFT_LED_Pin, on ? GPIO_PIN_SET : GPIO_PIN_RESET);
}

void tft_init(void)
{
    /* MADCTL theo huong xoay: MY MX MV */
    static const uint8_t madctl[4] = { 0x00, 0x60, 0xC0, 0xA0 };
    uint8_t rot = CFG_TFT_ROTATION & 3u;
    uint8_t v;

    HAL_GPIO_WritePin(TFT_RESET_GPIO_Port, TFT_RESET_Pin, GPIO_PIN_RESET);
    HAL_Delay(20);
    HAL_GPIO_WritePin(TFT_RESET_GPIO_Port, TFT_RESET_Pin, GPIO_PIN_SET);
    HAL_Delay(120);

    write_cmd(0x01, NULL, 0);           /* software reset */
    HAL_Delay(150);
    write_cmd(0x11, NULL, 0);           /* sleep out */
    HAL_Delay(120);

    v = 0x55;                           /* 16 bit/pixel */
    write_cmd(0x3A, &v, 1);

    v = madctl[rot];
#if CFG_TFT_CONTROLLER == TFT_ILI9341
    v ^= 0x40;                          /* ILI9341 module thuong guong X */
    v |= 0x08;                          /* BGR */
#elif CFG_TFT_CONTROLLER == TFT_ST7735
    v |= 0x08;
#endif
    write_cmd(0x36, &v, 1);

#if CFG_TFT_CONTROLLER == TFT_ST7789
    write_cmd(0x21, NULL, 0);           /* ST7789 IPS can dao mau */
#endif
    write_cmd(0x13, NULL, 0);           /* normal display */
    write_cmd(0x29, NULL, 0);           /* display on */
    HAL_Delay(20);

    if (rot & 1u) { width = NATIVE_H; height = NATIVE_W; }
    else          { width = NATIVE_W; height = NATIVE_H; }

    tft_fill(TFT_BLACK);
    tft_backlight(1);
}

uint16_t tft_width(void)  { return width; }
uint16_t tft_height(void) { return height; }

void tft_fill_rect(uint16_t x, uint16_t y, uint16_t w, uint16_t h, uint16_t color)
{
    uint8_t line[64];
    if (x >= width || y >= height || w == 0 || h == 0) { return; }
    if (x + w > width)  { w = (uint16_t)(width - x); }
    if (y + h > height) { h = (uint16_t)(height - y); }

    for (unsigned i = 0; i < sizeof(line); i += 2) {
        line[i] = (uint8_t)(color >> 8);
        line[i + 1] = (uint8_t)color;
    }
    set_window(x, y, (uint16_t)(x + w - 1), (uint16_t)(y + h - 1));
    cs(0);
    dc(1);
    uint32_t n = (uint32_t)w * h * 2u;
    while (n) {
        uint16_t k = (n > sizeof(line)) ? (uint16_t)sizeof(line) : (uint16_t)n;
        spi_tx(line, k);
        n -= k;
    }
    cs(1);
}

void tft_fill(uint16_t color)
{
    tft_fill_rect(0, 0, width, height, color);
}

static void draw_char(uint16_t x, uint16_t y, char c, uint16_t fg, uint16_t bg, uint8_t s)
{
    /* Ve ca o 6x8 (kem 1 cot cach + 1 hang duoi) trong 1 lan dat cua so */
    uint8_t px[2 * 6 * 4];               /* toi da 1 hang pixel voi scale 4 */
    if (c < 0x20 || c > 0x7E) { c = '?'; }
    const uint8_t *g = font5x7[c - 0x20];
    uint16_t cw = (uint16_t)(6 * s), ch = (uint16_t)(8 * s);
    if (x + cw > width || y + ch > height) { return; }

    set_window(x, y, (uint16_t)(x + cw - 1), (uint16_t)(y + ch - 1));
    cs(0);
    dc(1);
    for (uint8_t row = 0; row < 8; row++) {
        uint16_t n = 0;
        for (uint8_t col = 0; col < 6; col++) {
            uint16_t color = (col < 5 && (g[col] >> row) & 1u) ? fg : bg;
            for (uint8_t k = 0; k < s; k++) {
                px[n++] = (uint8_t)(color >> 8);
                px[n++] = (uint8_t)color;
            }
        }
        for (uint8_t k = 0; k < s; k++) { spi_tx(px, n); }
    }
    cs(1);
}

uint16_t tft_text(uint16_t x, uint16_t y, const char *s, uint16_t fg, uint16_t bg, uint8_t scale)
{
    if (scale < 1) { scale = 1; }
    if (scale > 4) { scale = 4; }
    while (*s) {
        draw_char(x, y, *s++, fg, bg, scale);
        x = (uint16_t)(x + 6 * scale);
    }
    return x;
}
